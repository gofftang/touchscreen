## ft6x06/Kconfig
```kconfig
#
# Touchscreen driver configuration
#

config TOUCHSCREEN_FT6X06
       tristate  "FT6X06 touchscreen driver"
       depends on INPUT && I2C
       default n
       help
         FT6306,FT6206 touchscreen driver

if TOUCHSCREEN_FT6X06
config TOUCHSCREEN_FT6X06_POINT
       int  "FT6X06 touchscreen maximum touch point"
       range 1 5
       default 1
       help
         FT6306,FT6206 touchscreen maximum touch point

config TOUCHSCREEN_FT6X06_FW_UPG
       tristate  "FT6X06 touchscreen firmware upgrade"
       default n
       help
         FT6306,FT6206 touchscreen firmware upgrade
endif
```

## gslx680/Kconfig
```kconfig
#
#  Touchscreen driver configuration
#
config  TOUCHSCREEN_GSLX680
       tristate  "GSLX680 touchscreen driver"
       depends on INPUT && I2C
       default n
       help
         GSL1680,GSL2680,GSL3680 touchscreen driver

if TOUCHSCREEN_GSLX680
config  TOUCHSCREEN_GSLX680_ANTI_SHAKE
       tristate  "GSLX680 software anti-shake support"
       depends on INPUT && I2C
       default n
       help
         GSL1680,GSL2680,GSL3680 software anti-shake support
endif
```
